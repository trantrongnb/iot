/*
 * THU CAU NOI - ESP32-S3 + MAX98357A - Arduino-ESP32 3.x
 * Mot file .ino, am thanh da nhung san trong flash. Khong can Wi-Fi/API/PSRAM.
 * Cau mau: "Xin chào. Hệ thống hỗ trợ người khiếm thị đã sẵn sàng." (giong tieng Viet, tao qua Google Translate TTS).
 * BCLK=41, WS/LRC=40, DIN=42. MAX98357A VIN=5V, GND chung ESP32.
 * HC-6136: OUT=GPIO47, VCC=3V3, GND=GND; nhan LOW.
 * Nhan nut hoac gui 'p' Serial 115200 de phat; '+/-' chinh am luong, 's' trang thai.
 * Giu nut chi phat mot lan; nha roi nhan lai. Khong xep hang khi dang phat.
 * PCM16 mono 16kHz nhung trong flash, nhan doi sang stereo Philips I2S.
 * Muon thay cau noi thi can tao lai du lieu PCM, khong chi sua chu trong comment.
 */
#include <Arduino.h>
#include <ESP_I2S.h>
#if !defined(CONFIG_IDF_TARGET_ESP32S3)
#error "Hay chon ESP32S3 Dev Module"
#endif
constexpr int I2S_BCLK=41, I2S_WS=40, I2S_DOUT=42;
constexpr int BUTTON_PIN=47, BUTTON_PRESSED_LEVEL=LOW;
constexpr uint32_t BUTTON_DEBOUNCE_MS=40, SAMPLE_RATE=16000;
constexpr size_t BUFFER_FRAMES=256;
I2SClass audio;
bool audioReady=false, buttonArmed=false, playing=false, playRequested=false;
int buttonRaw=HIGH, buttonStable=HIGH;
uint32_t buttonChangedAt=0;
int volumePercent=65;
int16_t samples[BUFFER_FRAMES*2];

// PCM signed 16-bit mono, flash (khong sao chep ca cau vao RAM).
const int16_t SPEECH_PCM[] PROGMEM = {
  0,0,0,0,0,0,0,0,0,0,0,0,0,0,0,0,0,0,0,0,
  0,0,0,0,0,0,0,0,0,0,0,0,0,0,0,0,0,0,0,0,
  0,0,0,0,0,0,0,0,0,0,0,0,0,0,0,0,0,0,0,0,
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  0,0,0,0,0,0,0,0,
};
constexpr size_t SPEECH_FRAMES=sizeof(SPEECH_PCM)/sizeof(SPEECH_PCM[0]);

void resetButton() {
  buttonRaw = digitalRead(BUTTON_PIN);
  buttonStable = buttonRaw;
  buttonChangedAt = millis();
  buttonArmed = false;
}

bool buttonPressed() {
  const int raw = digitalRead(BUTTON_PIN);
  if (raw != buttonRaw) {
    buttonRaw = raw;
    buttonChangedAt = millis();
  }
  if (millis() - buttonChangedAt < BUTTON_DEBOUNCE_MS) return false;
  if (buttonRaw != buttonStable) {
    buttonStable = buttonRaw;
    Serial.printf("[NUT GPIO] GPIO%d=%s (%d) - %s\n", BUTTON_PIN,
                  buttonStable == HIGH ? "HIGH" : "LOW", buttonStable,
                  buttonStable == BUTTON_PRESSED_LEVEL ? "NHAN" : "NHA");
  }
  if (buttonRaw != BUTTON_PRESSED_LEVEL) {
    buttonArmed = true;
    return false;
  }
  if (!buttonArmed) return false;
  buttonArmed = false;
  return true;
}


void handleSerialCommands() {
  while (Serial.available()) {
    const char command=char(Serial.read());
    if(command=='+' || command=='-') {
      volumePercent=constrain(volumePercent+(command=='+'?5:-5),5,100);
      Serial.printf("[AM LUONG] %d%%\n",volumePercent);
    } else if(command=='p' || command=='P') {
      if(!playing) playRequested=true;
    } else if(command=='s' || command=='S') {
      Serial.printf("[STATUS] audio=%s GPIO%d=%d volume=%d%% playing=%d\n",
        audioReady?"OK":"NO",BUTTON_PIN,digitalRead(BUTTON_PIN),volumePercent,playing);
    }
  }
}

bool writeSamples(size_t frames) {
  const uint8_t *bytes = reinterpret_cast<const uint8_t *>(samples);
  const size_t total = frames * 2 * sizeof(int16_t);
  size_t sent = 0;
  while (sent < total) {
    const size_t n = audio.write(bytes + sent, total - sent);
    if (!n) {
      Serial.printf("[LOI] Ghi I2S that bai: %d\n", audio.lastError());
      audioReady = false;
      return false;
    }
    sent += n;
  }
  return true;
}


bool silence(uint32_t durationMs) {
  memset(samples,0,sizeof(samples));
  uint32_t remaining=SAMPLE_RATE*durationMs/1000;
  while(remaining) {
    const size_t frames=min(size_t(remaining),BUFFER_FRAMES);
    if(!writeSamples(frames)) return false;
    remaining-=frames;
  }
  return true;
}

void playSentence() {
  playing=true;
  playRequested=false;
  Serial.println("[PHAT] Xin chào. Hệ thống hỗ trợ người khiếm thị đã sẵn sàng.");
  if(silence(100)) {
    for(size_t offset=0;offset<SPEECH_FRAMES;) {
      handleSerialCommands();
      const size_t frames=min(BUFFER_FRAMES,SPEECH_FRAMES-offset);
      for(size_t i=0;i<frames;++i) {
        int32_t value=int32_t(pgm_read_word(&SPEECH_PCM[offset+i]));
        value=int32_t(int16_t(value))*volumePercent/100;
        // Fade 10 ms o dau/cuoi de giam tieng tach khi bat/tat.
        const size_t index=offset+i, tail=SPEECH_FRAMES-1-index;
        if(index<160) value=value*int32_t(index)/160;
        if(tail<160) value=value*int32_t(tail)/160;
        samples[2*i]=samples[2*i+1]=int16_t(value);
      }
      if(!writeSamples(frames)) break;
      offset+=frames;
    }
    if(audioReady) silence(150);  // Day het du lieu cau noi khoi DMA.
  }
  resetButton();
  playing=false;
  Serial.println(audioReady?"[XONG] Nha nut roi nhan lai, hoac gui p.":"[LOI] I2S dung. Xem log, reset de thu lai.");
}

void setup() {
  Serial.begin(115200);
  delay(1500);
  Serial.println("\nTHU CAU NOI - BCLK=41 WS=40 DIN=42, nut GPIO47");
  Serial.println("Cau mau: Xin chào. Hệ thống hỗ trợ người khiếm thị đã sẵn sàng.");
  pinMode(BUTTON_PIN,INPUT_PULLUP);
  resetButton();
  audio.setPins(I2S_BCLK,I2S_WS,I2S_DOUT);
  audioReady=audio.begin(I2S_MODE_STD,SAMPLE_RATE,I2S_DATA_BIT_WIDTH_16BIT,
                         I2S_SLOT_MODE_STEREO,I2S_STD_SLOT_BOTH);
  if(!audioReady) {
    Serial.printf("[LOI] Khoi tao I2S: %d\n",audio.lastError());
    return;
  }
  Serial.printf("[OK] PCM16 stereo 16000Hz, cau dai %.2f giay, volume=%d%%\n",
                float(SPEECH_FRAMES)/SAMPLE_RATE,volumePercent);
  Serial.println("Nhan nut de noi. Serial: p=phat, +/-=am luong, s=trang thai.");
  silence(300);
}

void loop() {
  if(!audioReady) {delay(100);return;}
  handleSerialCommands();
  const bool pressed=buttonPressed();
  if(pressed || playRequested) playSentence();
  if(audioReady) silence(16);  // Giu clock I2S khi cho.
}
